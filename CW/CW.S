/*
 * Курсова робота: Реалізація обчислювального алгоритму на емуляторі QEMU
 * для STM32F407VG (Cortex-M4)
 * 
 * Обчислення виразу: F = (((X₁ | (X₂ >> 1)) >> 3) - 2 × (X₃ ⊕ 1))
 * Початкові умови: X₁ = 18, X₂ = -9, X₃ = 23
 * Представлення: доповняльний код (two's complement)
 */

    .syntax unified
    .cpu cortex-m4
    .thumb

    /* Початкові значення */
    .equ X1_VAL, 18         /* X₁ = 18 (0x12) */
    .equ X2_VAL, -9         /* X₂ = -9 (0xFFFFFFF7) */
    .equ X3_VAL, 23         /* X₃ = 23 (0x17) */

    .global compute_formula
    .type compute_formula, %function

/*
 * Функція обчислення формули F = (((X₁ | (X₂ >> 1)) >> 3) - 2 × (X₃ ⊕ 1))
 * Використовує регістри:
 * - r4 (Rx): зберігає X₁, потім проміжні результати
 * - r5 (Ry): зберігає X₂
 * - r6 (R3): зберігає X₃
 * - r7 (CT): лічильник зсувів
 * Результат повертається в r0
 */
compute_formula:
    push    {r4-r7, lr}       /* Зберегти регістри на стеку */

    /* Крок 1: MOV Rx, #18 - завантаження X₁ */
    mov     r4, #X1_VAL       /* r4 (Rx) = 18 (0x12) */

    /* Крок 2: MOV Ry, #-9 - завантаження X₂ */
    mov     r5, #X2_VAL       /* r5 (Ry) = -9 (0xFFFFFFF7) */

    /* Крок 3: MOV R3, #23 - завантаження X₃ */
    mov     r6, #X3_VAL       /* r6 (R3) = 23 (0x17) */

    /* Крок 4: ASR Ry, #1 - арифметичний зсув X₂ вправо на 1 */
    asr     r5, r5, #1        /* r5 = -9 >> 1 = -5 (0xFFFFFFFB) */

    /* Крок 5: ORR Rx, Ry - побітове АБО: X₁ | (X₂ >> 1) */
    orr     r4, r4, r5        /* r4 = 18 | (-5) = -1 (0xFFFFFFFF) */

    /* Крок 6: MOV CT, #3 - завантаження лічильника зсувів */
    mov     r7, #3            /* r7 (CT) = 3 */

    /* Кроки 7-9: ASR Rx, #1 ×3 - три послідовні арифметичні зсуви */
shift_loop:
    asr     r4, r4, #1        /* Арифметичний зсув вправо на 1 */
    subs    r7, r7, #1        /* Декремент лічильника */
    bne     shift_loop        /* Продовжити якщо CT ≠ 0 */
    /* Результат: r4 = -1 >> 3 = -1 (0xFFFFFFFF) */

    /* Крок 10: EOR R3, #1 - побітове ВИКЛЮЧНЕ АБО: X₃ ⊕ 1 */
    eor     r6, r6, #1        /* r6 = 23 ⊕ 1 = 22 (0x16) */

    /* Крок 11: LSL R3, #1 - множення на 2 через логічний зсув вліво */
    lsl     r6, r6, #1        /* r6 = 22 << 1 = 44 (0x2C) */

    /* Крок 12: SUB Rx, R3 - фінальна операція віднімання */
    sub     r4, r4, r6        /* r4 = -1 - 44 = -45 (0xFFFFFFD3) */

    /* Результат у r0 для повернення */
    mov     r0, r4            /* F = -45 */

    pop     {r4-r7, pc}       /* Відновити регістри та повернутися */
    .size compute_formula, .-compute_formula

/*
 * Функція перевірки коректності обчислень
 * Виконує контрольні перевірки згідно з алгоритмом верифікації
 */
    .global verify_result
    .type verify_result, %function

verify_result:
    push    {r4-r6, lr}

    /* Зберегти результат для аналізу */
    mov     r4, r0            /* r4 = результат обчислення F */

    /* Перевірка на переповнення - аналіз знакових бітів */
    /* Для Cortex-M4: перевірка APSR flags після операцій */
    
    /* Перевірка на нуль у молодшій частині */
    and     r5, r4, #0xFF     /* Виділити молодший байт */
    cmp     r5, #0            /* Порівняти з нулем */
    
    /* Нормалізація та перевірка зсуву */
    /* Аналіз правильності арифметичних зсувів */
    
    /* Результат перевірки в r0: 0 = OK, інше = помилка */
    mov     r0, #0            /* Статус: успішна перевірка */

    pop     {r4-r6, pc}
    .size verify_result, .-verify_result

/*
 * Головна функція програми
 */
    .global main_program
    .type main_program, %function

main_program:
    push    {lr}

    /* Виконати обчислення формули */
    bl      compute_formula   /* Результат у r0 */

    /* Виконати перевірку результату */
    bl      verify_result     /* Статус перевірки у r0 */

    pop     {pc}
    .size main_program, .-main_program
